## XS.EDONGLEV3.01.01.10-ImageBuilder-20221124/target/linux/gem6xxx/image/Config.in
```kconfig
config DEVICE_TYPE
	string "device type"
	depends on TARGET_gem6xxx
	default ""
	help
	    Currently supported types: datacard, cpe and mifi.

config BOOTIMG_OFFSET_BASE
	string "boot.img base address"
	depends on TARGET_gem6xxx
	default "0x40000000"

config BOOTIMG_OFFSET_KERNEL
	string "boot.img kernel offset"
	depends on TARGET_gem6xxx
	default "0x00080000"

config BOOTIMG_OFFSET_SECOND
	string "boot.img 2nd bootloader offset"
	depends on TARGET_gem6xxx
	default "0x03C00000"

config BOOTIMG_OFFSET_TAGS
	string "boot.img tags offset"
	depends on TARGET_gem6xxx
	default "0x02F00000"

config BOOTING_DEVICE
	string "Booting storage type (emmc/nand)"
	depends on TARGET_gem6xxx
	default "emmc"

config UBIFS_OPTS
	string "UBIFS - install image options"
	depends on TARGET_gem6xxx
	default "-m 4KiB -e 248KiB -c 4096"

config UBI_OPS
	string "UBIFS - UbinizeImage options"
	depends on TARGET_gem6xxx
	default "-m 4KiB -p 256KiB"
```

## imagebuilder/target/linux/gem6xxx/Config.in
```kconfig
config MTK_MODEM_BIN_DIR
	string "Use MTK MODEM binaries in specific directory"
	depends on TARGET_gem6xxx
	default ""
	help
	  Instruct build system to use the MODEM binaries in the directory located
	  in the provided path. If empty, build system searches the directory with
	  predefined default rules.

config REQUIRED_BIN_DIR_FILES
	string "List of required files in BIN_DIR after a successful build"
	depends on TARGET_gem6xxx
	default ""
	help
	  Register the file paths, relative to BIN_DIR, that are considered required
	  after a build. Separate multiple files with space. For example:
	  "boot.img packages/Packages". The list can be fetched in build time to
	  check if all files are installed as expected.

config MTK_PLATFORM
	string "MTK platform name"
	depends on TARGET_gem6xxx
	default "mt6890"
	help
	    mt6880 or mt6890

config MTK_MDBIN_PLATFORM
	string "Platform name of MTK MODEM binaries"
	depends on TARGET_gem6xxx
	default ""
	help
	  The platform indicates which set of MODEM binaries to use. In codebase
	  it represents the directory name of those MODEM binaries. The value is
	  supposed to be the same as CONFIG_MTK_PLATFORM except customized MODEM
	  binaries.
```
